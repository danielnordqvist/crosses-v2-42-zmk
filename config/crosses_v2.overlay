/* config/crosses.overlay */

#define MOUSE_LAYER_INDEX 7

/ {
    behaviors {
        /* 
           1. Create a master switch behavior that controls BOTH trackballs simultaneously.
           When triggered via hold-tap, ZMK sends state '1' on press, 
           and cleanly resets to state '0' when released.
        */
        my_dual_swap: my_dual_swap {
            compatible = "zmk,behavior-pipeline-switch";
            #binding-cells = <2>; // Expects: <Hold_State Release_State>
            switches = <&zip_periph_ball>, <&zip_central_ball>;
        };

        /* 
           2. Combine everything into a custom Hold-Tap behavior.
           - On Hold: Triggers 'my_dual_swap' (to swap the trackballs) 
                      AND forces a momentary layer switch (&mo) via a nested call.
           - On Tap: Outputs your clean alpha keypress code.
        */
        z_tb_swap: z_tb_swap {
            compatible = "zmk,behavior-hold-tap";
            #binding-cells = <2>;
            flavor = "hold-preferred";         
            tapping-term-ms = <200>;           
            bindings = <&my_dual_swap>, <&kp>;
        };
    };
};
