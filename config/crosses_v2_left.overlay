&zip_periph_ball {
    cursor {
        label = "Cursor";
        //layers = <7>;
        input-processors = <&zip_report_rate_limit 2>;
    };

    scroll_up {
        label = "Scroll Up";
        input-processors
          = <&zip_xy_to_scroll_mapper>
          , <&zip_scroll_scaler 1 16>
          , <&zip_report_rate_limit 16>;
    };

    scroll_down {
        label = "Scroll Down";
        input-processors
          = <&zip_xy_transform (INPUT_TRANSFORM_Y_INVERT)>
          , <&zip_xy_to_scroll_mapper>
          , <&zip_scroll_scaler 1 16>
          , <&zip_report_rate_limit 16>;
    };
};