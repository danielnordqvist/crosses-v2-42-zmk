/*
&zip_central_ball {
    cursor {
        label = "Cursor";
        input-processors
            = <&zip_xy_transform (INPUT_TRANSFORM_X_INVERT | INPUT_TRANSFORM_Y_INVERT)>
            , <&mouse_temp_layer 6 1000>
            , <&zip_report_rate_limit 4>;
    };
}; 
*/

// Right hand trackball listener configuration
    &trackball_central_listener {
        status = "okay";        
        // This is your default cursor behavior when layer 1 is NOT active
        input-processors
          = <&zip_xy_transform (INPUT_TRANSFORM_X_INVERT | INPUT_TRANSFORM_Y_INVERT)>
          , <&mouse_temp_layer 6 1000>
          , <&zip_report_rate_limit 4>;

        // When layer 1 is active, it intercepts the input and applies scroll rules instead
        scroller {
            layers = <7>; // Links directly to your scroll_layer index
            input-processors
              = <&zip_xy_transform (INPUT_TRANSFORM_X_INVERT | INPUT_TRANSFORM_Y_INVERT)>
              , <&zip_xy_to_scroll_mapper>
              , <&zip_scroll_scaler 1 8>
              , <&zip_report_rate_limit 16>;
        };
    };